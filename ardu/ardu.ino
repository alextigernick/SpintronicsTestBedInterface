#include <AccelStepper.h>

#define stepPin1 5
#define dirPin1  4
#define stepPin2 3
#define dirPin2  2

#define relay_pin 8
#define tempSensorA A0
#define tempSensorB A1
const static float temps1[] PROGMEM = {-272.15,416.99630629463684,342.5542517844518,305.9863391095304,282.5504578186643,265.6245919375292,252.53069928295133,241.93717897835472,233.091925295997,225.53139424385597,218.95107051053964,213.14091084255801,207.95034184055976,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-63.13973739268701,-70.54449256343861};
const static float temps2[] PROGMEM = {-272.15,432.2339076731296,354.6488134315348,316.6722169716397,292.3801844930887,274.85859857457126,261.31684232478915,250.36926108467878,241.2340452988584,233.42975248235848,226.64033249199593,220.6479169738908,215.29640463518393,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-61.759385795238245,-69.26051426606932};
//1024 values
//automatically generated from alexjones.xyz/projects/Tools/Thermistors/
//Resistors are setup as a voltage divider with the constant resistor on Vref and the thermistor on ground.
//Constant resistor should be about in the middle of the range of resistances for the desired temperature range
char c;
bool state = false;

#define BUFSIZE 64
char buf [BUFSIZE] = "";
char buf2 [BUFSIZE] = "";
long parms[10];
char dexs [10];
int i = 0,j,k;
bool done = true;
//AccelStepper Taxis(1, 5, 4); // step,dir
//AccelStepper Zaxis(1, 3, 2); // step,dir
//AccelStepper motors[] = {Taxis,Zaxis};
void setup() {
  Serial.begin(57600);
  pinMode(tempSensorA, INPUT);
  pinMode(tempSensorB, INPUT);
  pinMode(relay_pin, OUTPUT);
  digitalWrite(relay_pin, LOW);
  pinMode(stepPin1,OUTPUT); 
  pinMode(dirPin1,OUTPUT);
  pinMode(stepPin2,OUTPUT); 
  pinMode(dirPin2,OUTPUT);
  Serial.println("RD");
}
void loop() {
  /*motors[0].run();
  motors[1].run();
  if (!done && motors[0].distanceToGo() == 0 && motors[1].distanceToGo() == 0) {
    Serial.println("done");
    done = true;
  }*/
  while(Serial.available()){
    c = Serial.read();
    if (c != '\n') {
      buf[i] = c;
      i++;
    }
    else{
      buf[i] = ' ';
      command(buf,i);
      i = 0;
    }
  }
}
void command(char * buf, int len){
  if(*buf == 'm') motor_control(buf+1,len-1);
  else if(*buf == 'r') readTemps();
  else if(*buf == 'l') {      
    state = !state;
    digitalWrite(relay_pin, state);
  }
  else Serial.println("what");
}
void motor_control(char * buf, int len) {
  dexs[0] = 0;
  for (j=0,i=1; j <= len; j++) {
    if (buf[j] == ' ') {
      dexs[i] = j+1;
      i++;
    }
  }
  c = i;
  for(i = 0; i < c-1; i++){
    for(j = dexs[i], k = 0; j < dexs[i+1]; j++, k++)
      buf2[k] = buf[j];
    buf2[k] = 0;
    parms[i] = atol(buf2);
  }
  if(parms[0] < 0 || parms[0] > 1) return;
  
  if(parms[0] == 0) {stepM2(parms[1]);}
  else if(parms[0] == 1) {stepM1(parms[1]);}
  Serial.println("done");
  //motors[parms[0]].setMaxSpeed(parms[2]);
  done = false;
}
void stepM1(long num){
  if(num < 0){
  digitalWrite(dirPin1,HIGH); // Enables the motor to move in a particular direction
  num = -num;
  }
  else
  digitalWrite(dirPin1,LOW); // Enables the motor to move in a particular direction
  // Makes 200 pulses for making one full cycle rotation
  for(long x = 0; x < num; x++) {
    digitalWrite(stepPin1,HIGH); 
    delayMicroseconds(500); 
    digitalWrite(stepPin1,LOW); 
    delayMicroseconds(500); 
  }
}
void stepM2(long num){
  if(num < 0){
  digitalWrite(dirPin2,HIGH); // Enables the motor to move in a particular direction
  num = -num;
  }
  else
  digitalWrite(dirPin2,LOW); // Enables the motor to move in a particular direction
  // Makes 200 pulses for making one full cycle rotation
  for(long x = 0; x < num; x++) {
    digitalWrite(stepPin2,HIGH); 
    delayMicroseconds(500); 
    digitalWrite(stepPin2,LOW); 
    delayMicroseconds(500); 
  }
}
void readTemps() {
  int a,b;
  a = analogRead(tempSensorA);
  b = analogRead(tempSensorB);
  Serial.print("t:1:");
  Serial.print(pgm_read_float_near(&temps1[a]));
  Serial.print(":2:");
  Serial.println(pgm_read_float_near(&temps2[b]));
}
